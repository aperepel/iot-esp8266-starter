#include <ESP8266WiFi.h>
#include <ESP_SSD1306.h>
#include <SPI.h>            // only for compilation
#include <Wire.h>
#include <Button.h>
#include <Adafruit_GFX.h>

#define BUTTON_PIN D2
#define PULLUP true
#define INVERT true
#define DEBOUNCE_MS 20

#define OLED_RESET  16
#define PIN_SDA D4
#define PIN_SCL D6
#define I2C_ADDRESS 0x3c

#define HWX_LOGO_W 128
#define HWX_LOGO_H 49
#define OLED_WIDTH 128
#define OLED_HEIGHT 64

Button btn(BUTTON_PIN, PULLUP, INVERT, DEBOUNCE_MS);
ESP_SSD1306 oled(OLED_RESET);

unsigned long pressedAtMillis;
unsigned long const interval = 5000;
unsigned long pressedForMillis;

// hortonworks logo for a splash screen
byte img[] = { 0x0, 0x0, 0x0, 0x0, 0x0, 0x0, 0x0, 0x0, 0x0, 0x0, 0x0, 0x0, 0x0,
    0x0, 0x0, 0x0, 0x0, 0x0, 0x0, 0x0, 0x0, 0x0, 0x0, 0x0, 0x0, 0x0, 0x0, 0x1,
    0xe0, 0x0, 0x0, 0x0, 0x0, 0x0, 0x0, 0x0, 0x0, 0x0, 0x0, 0x0, 0x0, 0x0, 0x0,
    0x1, 0xfc, 0x0, 0x0, 0x0, 0x0, 0x0, 0x0, 0x0, 0x0, 0x0, 0x0, 0x0, 0x0, 0x0,
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    0x0, 0x0, 0x0 };

void splashLogo() {
  oled.clearDisplay();
  // center the logo
  oled.drawBitmap((OLED_WIDTH - HWX_LOGO_W) / 2,
                  (OLED_HEIGHT - HWX_LOGO_H) / 2,
                  img, HWX_LOGO_W, HWX_LOGO_H, WHITE);
  oled.display();
}

void setup() {
  Serial.begin(115200);
//  Wire.setClock(400000);
  Wire.begin(PIN_SDA, PIN_SCL);
  oled.begin(SSD1306_SWITCHCAPVCC, I2C_ADDRESS, true);
//  oled.clearDisplay();
  splashLogo();
  delay(2000);
  oled.clearDisplay();

  oled.setTextSize(1);
  oled.setTextColor(WHITE);
  oled.setCursor(0, 0);
  oled.setTextWrap(true);

  connectWiFi();
}

void connectWiFi() {
  WiFi.mode(WIFI_STA);

  // Start SmartConfig if necessary
  if (WiFi.SSID() == "") {

    Serial.println("Beginning SmartConfig");
    oled.println("Beginning SmartConfig");
    oled.display();
    WiFi.beginSmartConfig();

    while (WiFi.status() != WL_CONNECTED) {
      delay(1000);
      Serial.print(".");
      oled.print(".");
      oled.display();
      if (WiFi.smartConfigDone()) {
        Serial.println();
        Serial.println("SmartConfig completed");
        oled.println();
        oled.println("SmartConfig completed");
        oled.display();
        WiFi.stopSmartConfig();
        delay(2000);
        break;
      }
    }
  } else {
    Serial.println(String("Using a saved SSID: ") + WiFi.SSID());
    oled.println(String("Using a saved SSID: ") + WiFi.SSID());
    oled.display();
  }

  Serial.print("Connecting..");
  oled.print("Connecting...");
  oled.display();
  WiFi.begin();
  while (WiFi.status() != WL_CONNECTED) {
    delay(1000);
    Serial.print(".");
    oled.print(".");
    oled.display();
  }
  Serial.println("Ok");
  oled.println("Ok");
  oled.display();

  Serial.println(String("My IP: ") + WiFi.localIP().toString());
  oled.println(String("My IP: ") + WiFi.localIP().toString());
  oled.display();
  delay(3000);
}

void displayOff() {
  return oled.ssd1306_command(0xAE);
}

void displayOn() {
  oled.ssd1306_command(0xAF);
}

void loop() {
  btn.read();

  if (btn.wasPressed()) {
    pressedAtMillis = millis();
  }

  if (btn.wasReleased()) {
    if (pressedForMillis > interval) {
      // we have a long press, reset
      displayOn();
      Serial.println("Resetting WiFi credentials");
      oled.invertDisplay(true);
      oled.println("Resetting WiFi credentials");
      oled.display();
      WiFi.disconnect();

      delay(3000);
      ESP.restart();
    } else {
      // short press, turn on the display
      displayOn();
      splashLogo();
      oled.clearDisplay();
      delay(3000);
      oled.println(String("My IP: ") + WiFi.localIP().toString());
      oled.display();
      delay(3000);
      displayOff();
    }
  }

  pressedForMillis = millis() - pressedAtMillis;

  displayOff();

}
